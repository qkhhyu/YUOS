# file: YUOS.ioc
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Mcu.Family=STM32F4
Mcu.Name=STM32F407V(E-G)Tx
Mcu.Package=LQFP100
NVIC.PriorityGroup=NVIC_PRIORITYGROUP_4
PA13.Mode=Serial_Wire
PA13.Signal=SYS_JTMS-SWDIO
PA14.Mode=Serial_Wire
PA14.Signal=SYS_JTCK-SWCLK
PB2.GPIO_Label=LED_G
PB2.Signal=GPIO_Output
PC14-OSC32_IN.Mode=LSE-External-Oscillator
PC14-OSC32_IN.Signal=RCC_OSC32_IN
PC15-OSC32_OUT.Mode=LSE-External-Oscillator
PC15-OSC32_OUT.Signal=RCC_OSC32_OUT
PH0-OSC_IN.Mode=HSE-External-Oscillator
PH0-OSC_IN.Signal=RCC_OSC_IN
PH1-OSC_OUT.Mode=HSE-External-Oscillator
PH1-OSC_OUT.Signal=RCC_OSC_OUT
ProjectManager.HeapSize=0x200
ProjectManager.StackSize=0x400
ProjectManager.TargetToolchain=CMake
RCC.AHBFreq_Value=16000000
RCC.APB1Freq_Value=16000000
RCC.APB1TimFreq_Value=16000000
RCC.APB2Freq_Value=16000000
RCC.APB2TimFreq_Value=16000000
RCC.CortexFreq_Value=16000000
RCC.HCLKFreq_Value=16000000
RCC.HSE_VALUE=8000000
RCC.HSI_VALUE=16000000
RCC.SYSCLKFreq_VALUE=16000000
RCC.VCOOutputFreq_Value=192000000
board=custom

// file: Core/Src/main.c
/* USER CODE BEGIN Header */
/**
  ******************************************************************************
  * @file           : main.c
  * @brief          : Main program body
  ******************************************************************************
  * @attention
  *
  * Copyright (c) 2026 STMicroelectronics.
  * All rights reserved.
  *
  * This software is licensed under terms that can be found in the LICENSE file
  * in the root directory of this software component.
  * If no LICENSE file comes with this software, it is provided AS-IS.
  *
  ******************************************************************************
  */
/* USER CODE END Header */
#include "main.h"
#include <stdint.h>

void SystemClock_Config(void);
static void MX_GPIO_Init(void);

/* USER CODE BEGIN 0 */

// uint32_t taska_stack[STACK_SIZE];
// uint32_t taskb_stack[STACK_SIZE];

/* 任务控制块 */
struct yuos_kernel yuos_os={0};

struct yuos_tcb tcb_pool[YUOS_MAX_TASKS];
uint32_t stack_pool[YUOS_MAX_TASKS][STACK_SIZE];

struct yuos_tcb *yuos_idle_tcb;
struct yuos_tcb *taska_tcb, *taskb_tcb;
struct yuos_tcb *current_tcb;

struct yuos_tcb *ready_list;	//就绪队列
struct yuos_tcb *delay_list;	//延时队列

static void sem_wait_list_insert(struct yuos_sem *sem,struct yuos_tcb *tcb)
{
	struct yuos_tcb *pos = NULL;
	tcb->next = NULL;
	tcb->prev = NULL;
	if(sem->wait_list==NULL)
	{
		sem->wait_list = tcb;
		tcb->next = NULL;
	}
	else
	{
		pos = sem->wait_list;
		while(pos->next)
		{
			pos = pos->next;
		}
		pos->next = tcb;
		tcb->next = NULL;
	}
}

void yuos_sem_post(struct yuos_sem *sem)
{
	struct yuos_tcb *tcb = NULL;
	if(sem->wait_list)
	{
		tcb = sem->wait_list;
		tcb->state = TASK_READY;
		yuos_delay_list_remove(tcb);	// 从等待队列移除
		yuos_ready_list_insert(tcb);	// 插入到就绪队列
		SCB->ICSR |= SCB_ICSR_PENDSVSET_Msk;  // 切换到其他任务
	}
	else
	{
		sem->count++;
	}
}

void yuos_sem_wait(struct yuos_sem *sem)
{
	struct yuos_tcb *tcb = current_tcb;
	if(sem->count>0)
	{
		sem->count--;
	}
	else
	{
		tcb->state = TASK_BLOCKED;
		yuos_ready_list_remove(tcb);	// 从就绪队列移除
		yuos_delay_list_insert(tcb);	// 插入到等待队列
		SCB->ICSR |= SCB_ICSR_PENDSVSET_Msk;  // 切换到其他任务
	}
}

void yuos_sem_init(struct yuos_sem *sem, uint32_t count)
{
	sem->count = count;
	sem->wait_list = NULL;
}

static void yuos_list_insert_by_priority(struct yuos_tcb *tcb, struct yuos_tcb **list_head)
{
	struct yuos_tcb *pos;

	if (tcb == NULL || list_head == NULL)
	{
		return;
	}

	tcb->next = NULL;
	tcb->prev = NULL;
	if (*list_head == NULL)
	{
		*list_head = tcb;
		return;
	}

	if (tcb->priority < (*list_head)->priority)
	{
		tcb->next = *list_head;
		(*list_head)->prev = tcb;
		*list_head = tcb;
		return;
	}

	pos = *list_head;
	while (pos->next && tcb->priority >= pos->next->priority)
	{
		pos = pos->next;
	}

	tcb->next = pos->next;
	tcb->prev = pos;
	pos->next = tcb;
	if (tcb->next)
	{
		tcb->next->prev = tcb;
	}
}

static void yuos_list_insert_by_delay(struct yuos_tcb *tcb, struct yuos_tcb **list_head)
{
	struct yuos_tcb *pos;

	if (tcb == NULL || list_head == NULL)
	{
		return;
	}

	tcb->next = NULL;
	tcb->prev = NULL;

	if (*list_head == NULL)
	{
		*list_head = tcb;
		return;
	}

	if (tcb->delay_ticks < (*list_head)->delay_ticks)
	{
		tcb->next = *list_head;
		(*list_head)->prev = tcb;
		*list_head = tcb;
		return;
	}

	pos = *list_head;
	while (pos->next && tcb->delay_ticks >= pos->next->delay_ticks)
	{
		pos = pos->next;
	}

	tcb->next = pos->next;
	tcb->prev = pos;
	pos->next = tcb;
	if (tcb->next)
	{
		tcb->next->prev = tcb;
	}
}

static void yuos_list_remove(struct yuos_tcb *tcb, struct yuos_tcb **list_head)
{
	if (tcb == NULL || list_head == NULL)
	{
		return;
	}

	if (tcb->prev == NULL && tcb->next == NULL && *list_head != tcb)
	{
		return;
	}

	if (tcb->prev)
	{
		tcb->prev->next = tcb->next;
	}
	else
	{
		*list_head = tcb->next;
	}
	if (tcb->next)
	{
		tcb->next->prev = tcb->prev;
	}
	tcb->next = NULL;
	tcb->prev = NULL;
}

void yuos_ready_list_insert(struct yuos_tcb *tcb)
{
	yuos_list_insert_by_priority(tcb, &ready_list);
}

void yuos_delay_list_insert(struct yuos_tcb *tcb)
{
	yuos_list_insert_by_delay(tcb, &delay_list);
}

void yuos_ready_list_remove(struct yuos_tcb *tcb)
{
	yuos_list_remove(tcb, &ready_list);
}

void yuos_delay_list_remove(struct yuos_tcb *tcb)
{
	yuos_list_remove(tcb, &delay_list);
}

uint32_t enter_critical(void)
{
	uint32_t primask = __get_PRIMASK();  // 读取当前中断状态
	__disable_irq();
	return primask;                       // 返回旧状态，交给调用者保管
}

void exit_critical(uint32_t primask)
{
	__set_PRIMASK(primask);                 // 恢复到旧状态
}

__attribute__((noreturn)) void task_exit_handler(void);

/*
 * scheduler — 优先级调度
 */
void yuos_scheduler(void)
{
	struct yuos_tcb *next = ready_list;	// 从就绪队列头开始找最高优先级的任务
	if(next == NULL)
	{
		return; // 没有就绪任务，继续运行当前任务（可能是空闲任务）
	}
	yuos_ready_list_remove(next);	// 从就绪队列移除，准备切换到它
	uint32_t primask = enter_critical();
	if (current_tcb != next && current_tcb->state == TASK_RUNNING)
	{
		current_tcb->state = TASK_READY;
		yuos_ready_list_insert(current_tcb);	// 当前任务重新入就绪队列
	}
	current_tcb = next;
	current_tcb->state = TASK_RUNNING;
	current_tcb->last_tick = yuos_os.ticks;
  	current_tcb->time_slice = YUOS_TIME_SLICE;
	exit_critical(primask);
}

void task_sleep(uint32_t ticks)
{
	uint32_t primask = enter_critical();
	current_tcb->delay_ticks = ticks;
	current_tcb->state = TASK_BLOCKED;
	yuos_delay_list_insert(current_tcb);	// 插入到延时队列
	SCB->ICSR |= SCB_ICSR_PENDSVSET_Msk;  // 切换到其他任务
	exit_critical(primask);

}

void task_yield(void)
{
	uint32_t primask = enter_critical();
	current_tcb->state = TASK_READY;  // 标记当前任务为就绪
	yuos_ready_list_insert(current_tcb); // 重新插入就绪队列
	SCB->ICSR |= SCB_ICSR_PENDSVSET_Msk;  // 触发 PendSV 进行上下文切换
	exit_critical(primask);
}

/*
 * task_create — 初始化任务栈（PendSV 异常帧布局）
 *
 * 栈从高地址到低地址：
 *   xPSR, PC, LR, R12, R3, R2, R1, R0  ← 硬件自动压栈 (8 words)
 *   R11, R10, R9, R8, R7, R6, R5, R4    ← PendSV 手动压栈 (8 words)
 */
struct yuos_tcb *task_create(int stack_size,uint32_t priority, void (*task_func)(void))
{
    if(task_func==NULL)
	{
		return NULL;
	}
	if(priority>=YUOS_MAX_PRIORITIES)
	{
		return NULL;
	}
	if(stack_size > STACK_SIZE)
	{
		return NULL;
	}
	struct yuos_tcb *tcb = NULL;
	uint32_t *sp = NULL;
	int slot = -1;
	for(uint32_t i=0;i<YUOS_MAX_TASKS;i++)
	{
		if(tcb_pool[i].state == TASK_UNUSED)
		{
			tcb = &tcb_pool[i];
			slot = i;
			break;
		}
	}
	if(tcb==NULL)
	{
		return NULL; // 没有空闲的 TCB
	}
	sp = &stack_pool[slot][stack_size];
	sp = (uint32_t *)((uintptr_t)sp & ~(uintptr_t)0x7u);	// 8字节对齐
	stack_pool[slot][0] = 0xDEADBEEF;
    /* 硬件异常返回帧 —— bx lr 时硬件自动弹出 */
    *(--sp) = 0x01000000;           /* xPSR: 必须置 Thumb 位 */
    *(--sp) = (uint32_t)task_func;  /* PC:  首次运行入口 */
    *(--sp) = (uint32_t)task_exit_handler;           /* LR */
    *(--sp) = 0x00000000;           /* R12 */
    *(--sp) = 0x00000000;           /* R3  */
    *(--sp) = 0x00000000;           /* R2  */
    *(--sp) = 0x00000000;           /* R1  */
    *(--sp) = 0x00000000;           /* R0  */

    /* R4-R11 —— PendSV 手动弹出 */
    for (int i = 11; i >= 4; i--)
    {
        *(--sp) = i;
    }

    tcb->sp = sp;
    tcb->priority = priority;
    tcb->state = TASK_READY;
    tcb->delay_ticks = 0;
    tcb->time_slice = YUOS_TIME_SLICE;
	yuos_ready_list_insert(tcb);	// 创建后直接进入就绪队列
	return tcb;
}

/*
 * start_first_task — 通过 SVC 进入 Handler 模式，跳转到第一个任务
 * 不能在 Thread 模式下直接加载任务栈并 bx lr
 */
__attribute__((naked)) void start_first_task(void)
{
    __asm volatile (
        "svc 0    \n"  /* 触发 SVC 异常，进入 Handler 模式 */
        "bx lr    \n"
    );
}

/* USER CODE END 0 */

__attribute__((noreturn)) void task_exit_handler(void)
  {
      uint32_t primask = enter_critical();
      current_tcb->state = TASK_UNUSED;  // 标记任务槽为空
	  yuos_ready_list_remove(current_tcb);
      exit_critical(primask);

      SCB->ICSR |= SCB_ICSR_PENDSVSET_Msk;  // 切走
      while(1);  // 如果调度失败，死循环防飞
  }

void yuos_idle(void)
{
	while(1)
	{

	}
}

void taska(void)
{
	while(1)
	{
		for(int i=0;i<5;i++)
		{
			HAL_GPIO_WritePin(LED_G_GPIO_Port, LED_G_Pin, GPIO_PIN_SET);
			for (volatile int i = 0; i < 500000; i++);   // 慢闪忙等
			HAL_GPIO_WritePin(LED_G_GPIO_Port, LED_G_Pin, GPIO_PIN_RESET);
			for (volatile int i = 0; i < 500000; i++);
		}
		task_sleep(5000);

	}
}

void taskb(void)
{
	while(1)
	{
		HAL_GPIO_WritePin(LED_G_GPIO_Port, LED_G_Pin, GPIO_PIN_SET);
		for (volatile int i = 0; i < 2000000; i++);   // 慢闪忙等
		HAL_GPIO_WritePin(LED_G_GPIO_Port, LED_G_Pin, GPIO_PIN_RESET);
		for (volatile int i = 0; i < 2000000; i++);
	}
}

int main(void)
{

  /* MCU Configuration--------------------------------------------------------*/

  /* Reset of all peripherals, Initializes the Flash interface and the Systick. */
  HAL_Init();

  /* Configure the system clock */
  SystemClock_Config();

  /* Initialize all configured peripherals */
  MX_GPIO_Init();

  yuos_idle_tcb = task_create(STACK_SIZE,YUOS_PRIO_IDLE, yuos_idle);
  taska_tcb = task_create(STACK_SIZE,1, taska);
  taskb_tcb = task_create(STACK_SIZE,2, taskb);

  /*
   * PendSV 必须设为最低优先级 (15)。
   * 这样 PendSV 不会抢占 SysTick，保证上下文切换在 ISR 结束后才执行。
   */
  NVIC_SetPriority(PendSV_IRQn, 15);

  current_tcb = taska_tcb;
  start_first_task();  /* SVC → Handler 模式 → 跳转到 taska */

  /* 不会执行到这里 */
  while (1)
  {
  }
}
void SystemClock_Config(void)
{
  RCC_OscInitTypeDef RCC_OscInitStruct = {0};
  RCC_ClkInitTypeDef RCC_ClkInitStruct = {0};

  /** Configure the main internal regulator output voltage
  */
  __HAL_RCC_PWR_CLK_ENABLE();
  __HAL_PWR_VOLTAGESCALING_CONFIG(PWR_REGULATOR_VOLTAGE_SCALE1);

  /** Initializes the RCC Oscillators according to the specified parameters
  * in the RCC_OscInitTypeDef structure.
  */
  RCC_OscInitStruct.OscillatorType = RCC_OSCILLATORTYPE_HSI;
  RCC_OscInitStruct.HSIState = RCC_HSI_ON;
  RCC_OscInitStruct.HSICalibrationValue = RCC_HSICALIBRATION_DEFAULT;
  RCC_OscInitStruct.PLL.PLLState = RCC_PLL_NONE;
  if (HAL_RCC_OscConfig(&RCC_OscInitStruct) != HAL_OK)
  {
    Error_Handler();
  }

  /** Initializes the CPU, AHB and APB buses clocks
  */
  RCC_ClkInitStruct.ClockType = RCC_CLOCKTYPE_HCLK|RCC_CLOCKTYPE_SYSCLK
                              |RCC_CLOCKTYPE_PCLK1|RCC_CLOCKTYPE_PCLK2;
  RCC_ClkInitStruct.SYSCLKSource = RCC_SYSCLKSOURCE_HSI;
  RCC_ClkInitStruct.AHBCLKDivider = RCC_SYSCLK_DIV1;
  RCC_ClkInitStruct.APB1CLKDivider = RCC_HCLK_DIV1;
  RCC_ClkInitStruct.APB2CLKDivider = RCC_HCLK_DIV1;

  if (HAL_RCC_ClockConfig(&RCC_ClkInitStruct, FLASH_LATENCY_0) != HAL_OK)
  {
    Error_Handler();
  }
}

static void MX_GPIO_Init(void)
{
  GPIO_InitTypeDef GPIO_InitStruct = {0};

  /* GPIO Ports Clock Enable */
  __HAL_RCC_GPIOC_CLK_ENABLE();
  __HAL_RCC_GPIOH_CLK_ENABLE();
  __HAL_RCC_GPIOB_CLK_ENABLE();
  __HAL_RCC_GPIOA_CLK_ENABLE();

  /*Configure GPIO pin Output Level */
  HAL_GPIO_WritePin(LED_G_GPIO_Port, LED_G_Pin, GPIO_PIN_RESET);

  /*Configure GPIO pin : LED_G_Pin */
  GPIO_InitStruct.Pin = LED_G_Pin;
  GPIO_InitStruct.Mode = GPIO_MODE_OUTPUT_PP;
  GPIO_InitStruct.Pull = GPIO_NOPULL;
  GPIO_InitStruct.Speed = GPIO_SPEED_FREQ_LOW;
  HAL_GPIO_Init(LED_G_GPIO_Port, &GPIO_InitStruct);

}

void Error_Handler(void)
{
  __disable_irq();
  while (1)
  {
  }
}
